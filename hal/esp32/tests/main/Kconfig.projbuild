## hal/esp32/tests/main/Kconfig.projbuild
```kconfig
menu "WiFi Test Config"

config EXAMPLE_WIFI_SSID
    string "WiFi SSID"
    default ""

config EXAMPLE_WIFI_PASSWORD
    string "WiFi Password"
    default ""

endmenu
```

## hal/esp32/tests/sdkconfig.defaults
```kconfig
CONFIG_BT_ENABLED=y
CONFIG_BT_NIMBLE_ENABLED=y
CONFIG_PARTITION_TABLE_CUSTOM=y
CONFIG_PARTITION_TABLE_CUSTOM_FILENAME="partitions.csv"
CONFIG_ESPTOOLPY_FLASHSIZE_4MB=y
CONFIG_ESPTOOLPY_FLASHSIZE="4MB"

menu "WiFi Test Config"
    config EXAMPLE_WIFI_SSID
        string "WiFi SSID"
        default ""
    config EXAMPLE_WIFI_PASSWORD
        string "WiFi Password"
        default ""
endmenu
```
